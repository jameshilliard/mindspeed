## arch/arm/configs/optimus_uloader_defconfig
```kconfig
CONFIG_COMCERTO_ULOADER=y
CONFIG_M86297=y
# CONFIG_CMD_ARM_CPUINFO is not set
# CONFIG_ARM_EXCEPTIONS is not set
CONFIG_LOCALVERSION_AUTO_GIT_TAG_GLOB="gfiber*"
CONFIG_TEXT_BASE=0x83000000
CONFIG_MEMORY_LAYOUT_FIXED=y
CONFIG_STACK_BASE=0x8300c000
CONFIG_STACK_SIZE=0x1000
CONFIG_MALLOC_BASE=0x8300D000
CONFIG_MALLOC_SIZE=0x2C00
CONFIG_EXPERIMENTAL=y
CONFIG_PROMPT="uLoader >"
CONFIG_SHELL_NONE=y
CONFIG_MEM_SIZE=y
# CONFIG_TIMESTAMP is not set
# CONFIG_DEFAULT_ENVIRONMENT is not set
# CONFIG_SPI is not set
# CONFIG_OTP is not set
CONFIG_DRIVER_OTP=y
# CONFIG_FS_RAMFS is not set
# CONFIG_FS_DEVFS is not set
CONFIG_DIGEST=y
CONFIG_SHA1=y
CONFIG_AUTH=y
CONFIG_RSA_VERIFY=y
```

## arch/arm/configs/optimus_uloader_nand_defconfig
```kconfig
CONFIG_COMCERTO_NAND_ULOADER=y
CONFIG_M86297=y
# CONFIG_CMD_ARM_CPUINFO is not set
# CONFIG_ARM_EXCEPTIONS is not set
# CONFIG_CMD_MEMORY is not set
# CONFIG_LOCALVERSION_AUTO is not set
CONFIG_TEXT_BASE=0x83000000
CONFIG_MEMORY_LAYOUT_FIXED=y
CONFIG_STACK_BASE=0x8300c000
CONFIG_STACK_SIZE=0x4000
CONFIG_MALLOC_BASE=0x12000000
CONFIG_MALLOC_SIZE=0x800000
CONFIG_EXPERIMENTAL=y
CONFIG_MALLOC_DUMMY=y
CONFIG_PROMPT="uloader> "
CONFIG_SHELL_SIMPLE=y
# CONFIG_ERRNO_MESSAGES is not set
# CONFIG_TIMESTAMP is not set
# CONFIG_DEFAULT_ENVIRONMENT is not set
# CONFIG_CMD_TRUE is not set
# CONFIG_CMD_FALSE is not set
# CONFIG_CMD_LS is not set
# CONFIG_CMD_RM is not set
# CONFIG_CMD_CAT is not set
# CONFIG_CMD_MKDIR is not set
# CONFIG_CMD_RMDIR is not set
# CONFIG_CMD_CP is not set
# CONFIG_CMD_PWD is not set
# CONFIG_CMD_CD is not set
# CONFIG_CMD_MOUNT is not set
# CONFIG_CMD_UMOUNT is not set
# CONFIG_CMD_NOR is not set
# CONFIG_CMD_UPDATE_SPI is not set
# CONFIG_CMD_UPDATE_I2C is not set
# CONFIG_CMD_COPY is not set
# CONFIG_CMD_CLEAR is not set
# CONFIG_CMD_ECHO is not set
CONFIG_CMD_LOADY=y
# CONFIG_CMD_BOOTM is not set
# CONFIG_CMD_BOOTZ is not set
# CONFIG_CMD_BOOTU is not set
CONFIG_CMD_RESET=y
CONFIG_CMD_GO=y
# CONFIG_CMD_VERSION is not set
# CONFIG_CMD_HELP is not set
# CONFIG_CMD_DEVINFO is not set
# CONFIG_CMD_SOCINFO is not set
# CONFIG_CMD_GEMAC_STATS is not set
# CONFIG_CMD_PFE_STATS is not set
# CONFIG_CMD_PFE_COMMANDS is not set
# CONFIG_SPI is not set
CONFIG_MTD=y
CONFIG_NAND=y
# CONFIG_NAND_WRITE is not set
# CONFIG_NAND_ECC_SOFT is not set
# CONFIG_NAND_ECC_HW is not set
# CONFIG_NAND_ECC_HW_NONE is not set
# CONFIG_COMCERTO_NAND_ERASE_FBB is not set
# CONFIG_NAND_INFO is not set
# CONFIG_NAND_BBT is not set
# CONFIG_NAND_READ_OOB is not set
CONFIG_NAND_COMCERTO=y
CONFIG_DRIVER_OTP=y
# CONFIG_FS_RAMFS is not set
# CONFIG_FS_DEVFS is not set
```

## arch/arm/configs/spacecast_defconfig
```kconfig
CONFIG_COMCERTO_BOOTLOADER=y
CONFIG_TEXT_BASE=0x1000000
CONFIG_MEMORY_LAYOUT_FIXED=y
CONFIG_STACK_BASE=0x05000000
CONFIG_MALLOC_BASE=0x05008000
CONFIG_MALLOC_SIZE=0x0AFF8000
CONFIG_EXPERIMENTAL=y
CONFIG_PROMPT="Barebox-SC >"
CONFIG_LONGHELP=y
CONFIG_GLOB=y
CONFIG_HUSH_GETOPT=y
CONFIG_CMDLINE_EDITING=y
CONFIG_AUTO_COMPLETE=y
CONFIG_MEM_SIZE=y
CONFIG_PARTITION=y
CONFIG_DEFAULT_ENVIRONMENT_PATH="arch/arm/boards/optimus/env_spacecast"
CONFIG_ANTIREBOOTLOOP=y
CONFIG_CMD_EDIT=y
CONFIG_CMD_SAVEENV=y
CONFIG_CMD_LOADENV=y
CONFIG_CMD_EXPORT=y
CONFIG_CMD_PRINTENV=y
CONFIG_CMD_HNVRAM=y
CONFIG_CMD_READLINE=y
# CONFIG_CMD_UPDATE_FAST_SPI is not set
CONFIG_CMD_LOADB=y
CONFIG_CMD_LOADY=y
CONFIG_CMD_MEMINFO=y
CONFIG_CMD_CRC=y
CONFIG_CMD_CRC_CMP=y
CONFIG_CMD_FLASH=y
CONFIG_CMD_BOOTM_SHOW_TYPE=y
CONFIG_CMD_RESET=y
CONFIG_CMD_GO=y
CONFIG_CMD_OTP_KEY=y
CONFIG_CMD_OTP_STABILITY_TEST=y
CONFIG_CMD_TIMEOUT=y
CONFIG_CMD_PARTITION=y
CONFIG_CMD_I2C=y
CONFIG_NET=y
CONFIG_NET_DHCP=y
CONFIG_NET_PING=y
CONFIG_NET_TFTP=y
CONFIG_NET_TFTP_PUSH=y
CONFIG_NET_COMCERTO=y
CONFIG_NET_COMCERTO_2000=y
CONFIG_I2C=y
CONFIG_I2C_C2K=y
CONFIG_DRIVER_CFI=y
CONFIG_CFI_BUFFER_WRITE=y
CONFIG_MTD=y
CONFIG_UBI=y
CONFIG_DRIVER_OTP=y
CONFIG_FS_CRAMFS=y
CONFIG_DIGEST=y
CONFIG_SHA1=y
CONFIG_AUTH=y
CONFIG_RSA_VERIFY=y
```

## drivers/tpm/Kconfig
```kconfig
menu "TPM driver                "

config TPM
	bool "Enable TPM driver support"
	default n

config TPM_I2C_INFINEON
	depends on TPM && I2C
	bool "Enable driver for Infineon TPMs connected to an I2C bus"
	default n

endmenu
```

## lib/Kconfig
```kconfig
config ZLIB
	bool

config BZLIB
	bool

config CRC32
	bool

config CRC16
	bool

menuconfig DIGEST
	bool "Digest                        "

if DIGEST

config MD5
	bool "MD5"

config SHA1
	bool "SHA1"

config SHA256
	bool "SHA256"

endif

menuconfig AUTH
	bool "Authentication                "

if AUTH

config RSA_VERIFY
	bool "RSA_VERIFY"

choice
	prompt "Select the RSA key set"
	default RSA_KEY_SET_DEFAULT

config RSA_KEY_SET_DEFAULT
	bool "Default keys"

config RSA_KEY_SET_SPACECAST_PVT
	bool "SpaceCast PVT keys"

endchoice

endif

config GENERIC_FIND_NEXT_BIT
	def_bool n

config PROCESS_ESCAPE_SEQUENCE
	def_bool n

source lib/lzo/Kconfig
```
